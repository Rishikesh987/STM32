VERSION ""

NS_ :

BS_:

BU_: FLS ECU

BO_ 2147483904 OTA_Req: 8 FLS
 SG_ New_SW_Ver : 7|8@0+ (1,0) [0|255] "" Vector__XXX

BA_DEF_ BO_  "GenMsgSendType" ENUM  "FIX","EVENT","NO_EVE";
BA_DEF_ BO_  "GenMsgCycleTime" INT 0 0;
BA_DEF_ BO_  "CANFD_BRS" ENUM  "0","1";
BA_DEF_  "DBName" STRING ;
BA_DEF_  "BusType" STRING ;
BA_DEF_ BO_  "VFrameFormat" ENUM  "StandardCAN","ExtendedCAN","reserved","reserved","reserved","reserved","reserved","reserved","reserved","reserved","reserved","reserved","reserved","reserved","StandardCAN_FD","ExtendedCAN_FD";
BA_DEF_DEF_  "GenMsgSendType" "FIX";
BA_DEF_DEF_  "GenMsgCycleTime" 0;
BA_DEF_DEF_  "CANFD_BRS" "1";
BA_DEF_DEF_  "DBName" "";
BA_DEF_DEF_  "BusType" "";
BA_DEF_DEF_  "VFrameFormat" "StandardCAN";
BA_ "BusType" "CAN FD";
BA_ "DBName" "BTL";
BA_ "GenMsgSendType" BO_ 2147483904 1;
BA_ "GenMsgCycleTime" BO_ 2147483904 100;
BA_ "CANFD_BRS" BO_ 2147483904 0;
BA_ "VFrameFormat" BO_ 2147483904 1;
